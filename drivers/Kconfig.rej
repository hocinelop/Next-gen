## drivers/Kconfig.rej
```kconfig
--- drivers/Kconfig
+++ drivers/Kconfig
@@ -227,4 +227,5 @@ source "drivers/esoc/Kconfig"
 
 source "drivers/kernelsu-next/Kconfig"
 
+source "drivers/kernelsu/Kconfig"
 endmenu
```
